## main/Kconfig.projbuild
```kconfig
menu "Web Radio / Bluetooth Speaker"

    menu "Audio Output"
        choice
            prompt "Select Audio Output Mode"
            default AUDIO_OUTPUT_MODE_I2S
            help
                This option selects the audio output (but actual output is stored on hardware partition).
                So it's only for checks in case You want to disable Merus or VS1053 in Used Options menu.

            config AUDIO_OUTPUT_MODE_I2S
                bool "Generic I2S"
            config AUDIO_OUTPUT_MODE_I2S_MERUS
                bool "Merus Audio I2S"
            config AUDIO_OUTPUT_MODE_DAC_BUILT_IN
                bool "Built-In DAC"
            config AUDIO_OUTPUT_MODE_PDM
                bool "PDM"
            config AUDIO_OUTPUT_MODE_VS1053
                bool "VS1053"
            config AUDIO_OUTPUT_MODE_SPDIF
                bool "SPDIF"
            config AUDIO_OUTPUT_MODE_I2S_32
                bool "I2S_32BIT"
        endchoice

        config AUDIO_OUTPUT_MODE
            int
            default 0 if AUDIO_OUTPUT_MODE_I2S
            default 1 if AUDIO_OUTPUT_MODE_I2S_MERUS
            default 2 if AUDIO_OUTPUT_MODE_DAC_BUILT_IN
            default 3 if AUDIO_OUTPUT_MODE_PDM
            default 4 if AUDIO_OUTPUT_MODE_VS1053
            default 5 if AUDIO_OUTPUT_MODE_SPDIF
            default 6 if AUDIO_OUTPUT_MODE_I2S_32

    endmenu

    menu "Used Options"
        choice
            prompt "VS1053 support"
            default USE_VS1053 if AUDIO_OUTPUT_MODE_VS1053
            default USE_VS1053
            help
                You can switch it off in your build, but the flash memory savings are tiny default it's active
            config USE_VS1053
                bool "Enable VS1053"
            config NO_VS1053
                bool "Disable VS1053"
                 depends on !AUDIO_OUTPUT_MODE_VS1053
        endchoice

        choice
            prompt "Merus support"
            default USE_MERUS if AUDIO_OUTPUT_MODE_I2S_MERUS
            default USE_MERUS
            help
                You can switch it off in your build, but the flash memory savings are tiny default it's active
            config USE_MERUS
                bool "Enable MERUS"
            config NO_MERUS
                bool "Disable Merus"
                depends on !AUDIO_OUTPUT_MODE_I2S_MERUS
        endchoice

        choice
            prompt "Telnet support"
            default USE_TELNET
            help
                You can switch it off in your build, but the flash memory savings are tiny default it's active
                If NO_TELNET is selected all telnet related functions are not active saving some resources
            config USE_TELNET
                bool "Enable Telnet"
            config NO_TELNET
                bool "Disable Telnet"
        endchoice

        choice
            prompt "IR support"
            default USE_IRNEC
            help
                You can switch it off in your build, but there is no flash memory savings - default it's active
                If NO_IRNEC is selected all remote controll related functions are not active saving some resources
                but the ISR loop for reading IR input is blocked also with GPIO_NONE (P_IR_SIGNAL = 255)
            config USE_IRNEC
                bool "Enable IR"
            config NO_IRNEC
                bool "Disable IR"
        endchoice

        choice
            prompt "Touch support"
            default USE_XPT2046
            help
                You can switch it off in your build, but the flash memory savings are tiny default it's active
                If NO_XPT2046 is selected all Touch controll related functions are not active saving some resources
            config USE_XPT2046
                bool "Enable XPT"
            config NO_XPT2046
                bool "Disable XPT"
        endchoice

    endmenu

    menu "Encoder"
        choice
            prompt "Use PCNT hardware in encoder logic"
            default PCNT_ENC
            help
                This option lets you choose if encoders use hardware pulse counters PCNT in encoder logic
                or ISR-based pin read functions.

            config PCNT_ENC
                bool "use PCNT"
            config ISR_ENC
                bool "use ISR"
        endchoice
    endmenu

    menu "Display"
        choice
            prompt "Select display type"
            default DISPLAY_TYPE_ALL
            help
                This option selects the display type and try to prevent loading unused drivers and libraries.
                Select DISPLAY_TYPE_ALL for supporting both color and mono screens (default). 
                But keep in mind, that with 4MB flash there is no space for debug stuff if BT_mode is also active
                Selecting only one display library slightly reduces the final binary size.

            config DISPLAY_TYPE_NONE
                bool "No display"
            config DISPLAY_TYPE_MONO
                bool "Monochrome display (u8g2)"
            config DISPLAY_TYPE_COLOR
                bool "Color display (ucg)"
            config DISPLAY_TYPE_ALL
                bool "All display types"
        endchoice
    endmenu

    menu "Bluetooth"
        menuconfig BT_SPEAKER_MODE
            bool "Bluetooth Speaker Mode"
            default false if IDF_TARGET_ESP32S3
            default true if IDF_TARGET_ESP32
            depends on IDF_TARGET_ESP32 && BT_CLASSIC_ENABLED
            help
                Select this option to enable bluetooth speaker mode.
                Web radio streaming (and all other network functions) is unavailable in BT mode.
                Switching between modes - long press encoder button or bt.toggle from console 
                toggle the config and restarts ESP in new mode.

        config BT_NAME
            string "Bluetooth Name"
            default "KaRadio_SPEAKER"
            depends on BT_SPEAKER_MODE
            help
                Bluetooth name exposed by the device, initial value can be modifyied from Web browser or terminal command.
    endmenu

    menu "LED Configuration"
        choice
            prompt "Blink LED type"
            default BLINK_LED_GPIO if IDF_TARGET_ESP32
            default BLINK_LED_RMT if IDF_TARGET_ESP32S3
            help
                Defines the default peripheral for status blinking LED, If RMT is selected (default for ESP32S3) 
                not only LED blinking pattern is changing but also colours, if you have adressable LED 
                its an option for You, otherwise stick with standard GPIO.

            config BLINK_LED_GPIO
                bool "GPIO"
            config BLINK_LED_RMT
                bool "RMT - Addressable LED"
        endchoice

        config BLINK_LED_RMT_CHANNEL
            int "RMT Channel"
            range 0 7
            default 0
            depends on BLINK_LED_RMT
            help
                Set the RMT peripheral channel.
                ESP32 RMT channel from 0 to 7
                ESP32-S2 RMT channel from 0 to 3
                ESP32-S3 RMT channel from 0 to 3
                ESP32-C3 RMT channel from 0 to 1

        config BLINK_GPIO
            int "Blink GPIO number"
            range 0 48
            default 8 if IDF_TARGET_ESP32C3 || IDF_TARGET_ESP32H2
            default 18 if IDF_TARGET_ESP32S2
            default 48 if IDF_TARGET_ESP32S3
            default 2
            help
                GPIO number (IOxx) to blink on and off or the RMT signal for the addressable LED.
                Some GPIOs are used for other purposes (flash connections, etc.) and cannot be used to blink.
                The value here is not actually used (the hardware partition is the master)

        config BLINK_PERIOD
            int "Blink period in ms"
            range 10 3600000
            default 1000
            help
                Define the blinking period in milliseconds.

    endmenu

endmenu
```

## sdkconfig.defaults
```kconfig
#
# =========================================================
#  Flash / Partition
# =========================================================
#
CONFIG_ESPTOOLPY_FLASHMODE_DIO=y
CONFIG_ESPTOOLPY_FLASHSIZE_4MB=y
CONFIG_ESPTOOLPY_HEADER_FLASHSIZE_UPDATE=y
CONFIG_PARTITION_TABLE_CUSTOM=y

#
# =========================================================
#  CPU / Clock
# =========================================================
#
CONFIG_ESP_DEFAULT_CPU_FREQ_MHZ_240=y
CONFIG_ESP32_XTAL_FREQ_AUTO=y

#
# =========================================================
#  PSRAM (required)
# =========================================================
#
CONFIG_SPIRAM=y
CONFIG_SPIRAM_MODE_OCT=y
CONFIG_SPIRAM_SPEED_80M=y
CONFIG_SPIRAM_TRY_ALLOCATE_WIFI_LWIP=y

#
# =========================================================
#  FreeRTOS
# =========================================================
#
CONFIG_FREERTOS_ENABLE_BACKWARD_COMPATIBILITY=y
CONFIG_FREERTOS_ENABLE_TASK_SNAPSHOT=n
CONFIG_FREERTOS_TLSP_DELETION_CALLBACKS=n
CONFIG_FREERTOS_HZ=1000

#
# =========================================================
#  System / HAL
# =========================================================
#
CONFIG_HAL_WDT_USE_ROM_IMPL=n
CONFIG_ESP_ERR_TO_NAME_LOOKUP=n

#
# =========================================================
#  Logging (minimal)
# =========================================================
#
CONFIG_LOG_TIMESTAMP_SOURCE_SYSTEM=y
CONFIG_LOG_DEFAULT_LEVEL_ERROR=y
CONFIG_LOG_DEFAULT_LEVEL=1
CONFIG_LOG_MAXIMUM_LEVEL=1

#
# =========================================================
#  WiFi / LWIP
# =========================================================
#
CONFIG_ESP_WIFI_STATIC_RX_BUFFER_NUM=10
CONFIG_ESP_WIFI_RX_BA_WIN=6
CONFIG_LWIP_LOCAL_HOSTNAME="KaRadio"
CONFIG_LWIP_TCP_OOSEQ_MAX_PBUFS=4
CONFIG_LWIP_DNS_SETSERVER_WITH_NETIF=y

#
# =========================================================
#  Compiler / Size optimization
# =========================================================
#
CONFIG_COMPILER_OPTIMIZATION_SIZE=y
CONFIG_COMPILER_OPTIMIZATION_PERF=n
CONFIG_COMPILER_OPTIMIZATION_ASSERTIONS_SILENT=y

#
# =========================================================
#  SPI Flash
# =========================================================
#
CONFIG_SPI_FLASH_VERIFY_WRITE=y
CONFIG_SPI_FLASH_SUPPORT_BOYA_CHIP=y
CONFIG_SPI_FLASH_SUPPORT_TH_CHIP=y

#
# =========================================================
#  TLS backend selection (wolfSSL)
# =========================================================
#
CONFIG_ESP_TLS_USING_WOLFSSL_SPECIFIED=y
CONFIG_IGNORE_ESP_IDF_WOLFSSL_COMPONENT=y
CONFIG_CUSTOM_SETTING_WOLFSSL_ROOT="~/workspace/components/wolfssl"

CONFIG_USE_WOLFSSL_ESP_SDK_TIME=y
CONFIG_USE_WOLFSSL_ESP_SDK_WIFI=y

CONFIG_ESP_ENABLE_WOLFSSH=y
CONFIG_ESP_ENABLE_WOLFMQTT=n

CONFIG_ESP_WOLFSSL_TFM_TIMING_RESISTANT=y

#
# =========================================================
#  esp-tls options
# =========================================================
#
CONFIG_ESP_TLS_USE_SECURE_ELEMENT=n
CONFIG_ESP_TLS_SERVER_CERTIFICATE_VERIFY=n

#
# =========================================================
#  HTTP client
# =========================================================
#
CONFIG_ESP_HTTP_CLIENT_ENABLE_DIGEST_AUTH=n

#
# =========================================================
#  mbedTLS (hard disabled / size optimized)
# =========================================================
#
CONFIG_MBEDTLS_CERTIFICATE_BUNDLE=n
CONFIG_MBEDTLS_EXTERNAL_MEM_ALLOC=n
CONFIG_MBEDTLS_INTERNAL_MEM_ALLOC=n
CONFIG_MBEDTLS_DYNAMIC_BUFFER=n

# --- Certificates / context ---
CONFIG_MBEDTLS_X509_TRUSTED_CERT_CALLBACK=n
CONFIG_MBEDTLS_SSL_CONTEXT_SERIALIZATION=n

# --- Protocols ---
CONFIG_MBEDTLS_SSL_PROTO_SSL3=n
CONFIG_MBEDTLS_SSL_PROTO_GMTSSL1_1=n
CONFIG_MBEDTLS_SSL_PROTO_DTLS=n

# --- Ciphers ---
CONFIG_MBEDTLS_CAMELLIA_C=n
CONFIG_MBEDTLS_DES_C=n
CONFIG_MBEDTLS_BLOWFISH_C=n
CONFIG_MBEDTLS_XTEA_C=n
CONFIG_MBEDTLS_RIPEMD160_C=n
CONFIG_MBEDTLS_POLY1305_C=n
CONFIG_MBEDTLS_CHACHA20_C=n
CONFIG_MBEDTLS_HKDF_C=n

# --- ECP / Key exchange ---
CONFIG_MBEDTLS_ECP_RESTARTABLE=n
CONFIG_MBEDTLS_ECJPAKE_C=n
CONFIG_MBEDTLS_LARGE_KEY_SOFTWARE_MPI=n

# --- TLS features ---
CONFIG_MBEDTLS_PSK_MODES=n
CONFIG_MBEDTLS_TLS_SERVER_ONLY=n
CONFIG_MBEDTLS_TLS_CLIENT_ONLY=n
CONFIG_MBEDTLS_TLS_DISABLED=n
CONFIG_MBEDTLS_SSL_VARIABLE_BUFFER_LENGTH=n
```

## sdkconfig.defaults.esp32
```kconfig
#
# ===== Target =====
#
CONFIG_IDF_TARGET="esp32"
CONFIG_IDF_TARGET_ESP32=y
CONFIG_ESP32_XTAL_FREQ_40=y
CONFIG_ESP32_DEFAULT_CPU_FREQ_240=y
CONFIG_ESP32_DEFAULT_CPU_FREQ_MHZ=240

#
# ===== Flash =====
#
CONFIG_ESPTOOLPY_FLASHMODE_DIO=y
CONFIG_ESPTOOLPY_FLASHSIZE_4MB=y
CONFIG_ESPTOOLPY_FLASHFREQ_80M=y
CONFIG_BOOTLOADER_OFFSET_IN_FLASH=0x1000

#
# Bootloader config
#
CONFIG_BOOTLOADER_COMPILER_OPTIMIZATION_PERF=y

#
# Serial Flash Configurations
#
CONFIG_BOOTLOADER_SKIP_VALIDATE_IN_DEEP_SLEEP=y
CONFIG_BOOTLOADER_RESERVE_RTC_SIZE=0x10
CONFIG_BOOTLOADER_CUSTOM_RESERVE_RTC=y
CONFIG_BOOTLOADER_CUSTOM_RESERVE_RTC_SIZE=0x64

#
# ===== Partition table =====
#
CONFIG_PARTITION_TABLE_CUSTOM=y
CONFIG_PARTITION_TABLE_CUSTOM_FILENAME="partitions_4_MB.csv"
CONFIG_PARTITION_TABLE_FILENAME="partitions_4_MB.csv"

#
# ===== Display / UI =====
#
CONFIG_DISPLAY_TYPE_ALL=y

#
# ===== Bluetooth (Classic only, A2DP) =====
#
CONFIG_BT_ENABLED=y
CONFIG_BT_CLASSIC_ENABLED=y
CONFIG_BT_BLE_ENABLED=n

CONFIG_BTDM_CTRL_MODE_BR_EDR_ONLY=y
CONFIG_BTDM_CTRL_BR_EDR_MAX_ACL_CONN=2
CONFIG_BTDM_CTRL_BR_EDR_MAX_SYNC_CONN=0
CONFIG_BTDM_CTRL_BLE_MAX_CONN_EFF=0

CONFIG_BT_SPEAKER_MODE=y
CONFIG_BT_NAME="KaSpeaker"
CONFIG_BT_A2DP_USE_EXTERNAL_CODEC=y
CONFIG_BT_A2DP_AAC_DECODER=y
CONFIG_BT_A2DP_APTX_DECODER=y
CONFIG_BT_A2DP_APTX_VARIANT_HD=y
CONFIG_BT_A2DP_LDAC_DECODER=y
CONFIG_BT_ACL_CONNECTIONS=2

CONFIG_BT_A2DP_ENABLE=y
CONFIG_BT_STACK_NO_LOG=y
CONFIG_BT_SSP_ENABLED=n
CONFIG_BT_SMP_MAX_BONDS=5
CONFIG_BT_A2DP_SINK_BUF_SIZE=4096

# 🔻 FLASH saving
CONFIG_BT_SMP_ENABLE=n
CONFIG_BT_BLE_DYNAMIC_ENV_MEMORY=n
CONFIG_LCD_PANEL_IO_FORMAT_BUF_SIZE=0
CONFIG_OPENSSL_ERROR_STACK=n

# Allocate BT buffers from PSRAM first
CONFIG_BT_ALLOCATION_FROM_SPIRAM_FIRST=y

#
# ===== Blink LED =====
#
CONFIG_BLINK_LED_GPIO=y
CONFIG_BLINK_GPIO=2
CONFIG_BLINK_PERIOD=1000

#
# ===== PSRAM (required) =====
#
CONFIG_ESP32_SPIRAM_SUPPORT=y
CONFIG_SPIRAM_TYPE_AUTO=y
CONFIG_SPIRAM_SPEED_80M=y
CONFIG_SPIRAM_BOOT_INIT=y
CONFIG_SPIRAM_IGNORE_NOTFOUND=y
CONFIG_SPIRAM_ALLOW_BSS_SEG_EXTERNAL_MEMORY=y
CONFIG_SPIRAM_OCCUPY_HSPI_HOST=y

#  FLASH saving
CONFIG_SPIRAM_MEMTEST=n

# Prefer PSRAM for WiFi/LWIP buffers
CONFIG_SPIRAM_TRY_ALLOCATE_WIFI_LWIP=y

# Minimal internal heap safety
CONFIG_SPIRAM_MALLOC_ALWAYSINTERNAL=4096
CONFIG_SPIRAM_MALLOC_RESERVE_INTERNAL=8192

#  NO cache lib relocation (saves FLASH)
CONFIG_SPIRAM_CACHE_LIBTIME_IN_IRAM=n
CONFIG_SPIRAM_CACHE_LIBIO_IN_IRAM=n
CONFIG_SPIRAM_CACHE_LIBMATH_IN_IRAM=n
CONFIG_SPIRAM_CACHE_LIBMEM_IN_IRAM=n
CONFIG_SPIRAM_CACHE_LIBMISC_IN_IRAM=n

#
# ===== Logging =====
#
CONFIG_LOG_DEFAULT_LEVEL_INFO=y
CONFIG_LOG_DEFAULT_LEVEL=3
CONFIG_LOG_MAXIMUM_EQUALS_DEFAULT=y
CONFIG_LOG_MAXIMUM_LEVEL=3
CONFIG_NEWLIB_NANO_FORMAT=y
#
# ===== Panic / Heap =====
#
CONFIG_ESP_SYSTEM_PANIC_PRINT_HALT=y
CONFIG_HEAP_POISONING_DISABLED=y
CONFIG_HEAP_TRACING_OFF=y

#
# ===== Power / PM =====
#
CONFIG_PM_ENABLE=n

#
# ===== WiFi / LWIP minimal =====
#
CONFIG_ESP_WIFI_STATIC_RX_BUFFER_NUM=10
CONFIG_LWIP_TCP_OOSEQ_MAX_PBUFS=4
CONFIG_LWIP_DNS_SETSERVER_WITH_NETIF=y
CONFIG_LWIP_LOCAL_HOSTNAME="KaRadio"
CONFIG_ESP32_WIFI_TX_BA_WIN=8
CONFIG_ESP32_WIFI_RX_BA_WIN=24
CONFIG_ESP_WIFI_ESPNOW_MAX_ENCRYPT_NUM=0
CONFIG_ESP32_WIFI_ENABLE_WPA3_SAE=n
CONFIG_LWIP_IPV6=n
CONFIG_ETH_ENABLED=n
#
# ===== ADC / Calibration =====
#
CONFIG_ADC_CAL_EFUSE_TP_ENABLE=y
CONFIG_ADC_CAL_EFUSE_VREF_ENABLE=y
CONFIG_ADC_CAL_LUT_ENABLE=y

CONFIG_ESP32_REV_MIN_3=y
CONFIG_ESP32_RTC_CLK_SRC_INT_8MD256=y
CONFIG_ESP_ALLOW_BSS_SEG_EXTERNAL_MEMORY=y
CONFIG_ESP32_RTC_CLOCK_SOURCE_INTERNAL_8MD256=y
```
